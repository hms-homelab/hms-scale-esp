## main/Kconfig.projbuild
```kconfig
menu "Giraffe Scale Configuration"

config SCALE_MAC_ADDRESS
    string "Scale BLE MAC Address"
    default "D0:4D:00:51:4F:8F"
    help
        MAC address of the Etekcity BLE scale

config DEFAULT_SERVER
    string "Default Server (IP:Port)"
    default "hms-scale.local:8889"
    help
        Default hms-scale server address (configurable via captive portal)

config USER_AGE
    int "User Age"
    range 10 120
    default 30
    help
        User age for body metrics calculations

config USER_HEIGHT_CM
    int "User Height (cm)"
    range 100 250
    default 175
    help
        User height in centimeters

config USER_SEX_MALE
    bool "User Sex is Male"
    default y
    help
        Select if user is male (deselect for female)

endmenu
```
